## sdkconfig.defaults
```kconfig
CONFIG_ESPTOOLPY_MONITOR_BAUD=115200
CONFIG_PARTITION_TABLE_SINGLE_APP=y

# PSRAM (Ai-Thinker ESP32-CAM has 4MB PSRAM)
CONFIG_SPIRAM=y
CONFIG_SPIRAM_TYPE_ESPPSRAM64=y
CONFIG_SPIRAM_USE_CAPS_ALLOC=y
CONFIG_SPIRAM_IGNORE_NOTFOUND=y

# Camera
CONFIG_OV5640_SUPPORT=y
CONFIG_ESP_CAMERA_SUPPORTED=y
CONFIG_CAMERA_TASK_STACK_SIZE=12288

# Bluetooth Classic SPP
CONFIG_BT_ENABLED=y
CONFIG_BT_CLASSIC_ENABLED=y
CONFIG_BT_SPP_ENABLED=y

# FreeRTOS
CONFIG_FREERTOS_HZ=1000
CONFIG_FREERTOS_TICK_RATE_HZ=1000

# Watchdog (main loop resets it during long print operations)
CONFIG_ESP_TASK_WDT_EN=y
CONFIG_ESP_TASK_WDT_TIMEOUT_S=5

# Stacks
CONFIG_ESP_MAIN_TASK_STACK_SIZE=8192
CONFIG_ESP_SYSTEM_EVENT_TASK_STACK_SIZE=4096

# Optimise for size
CONFIG_COMPILER_OPTIMIZATION_SIZE=y
```
