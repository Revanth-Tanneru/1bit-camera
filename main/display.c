#include "display.h"
#include <string.h>
#include "driver/i2c.h"
#include "esp_log.h"
#include "freertos/FreeRTOS.h"
#include "freertos/task.h"

#define TAG   "DISPLAY"
#define ADDR  0x3C
#define I2C   I2C_NUM_0
#define SDA   13
#define SCL   14
#define W     128
#define H     64
#define PGS   (H / 8)

static uint8_t fb[W * PGS];

/* Standard 8×8 VGA font (ASCII 32–126, matches effects.c) */
static const uint8_t font8[95][8] = {
    {0x00,0x00,0x00,0x00,0x00,0x00,0x00,0x00},
    {0x18,0x18,0x18,0x18,0x18,0x00,0x18,0x00},
    {0x66,0x66,0x24,0x00,0x00,0x00,0x00,0x00},
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    {0x76,0xdc,0x00,0x00,0x00,0x00,0x00,0x00},
};

/* ── I2C helpers ────────────────────────────────────────────── */

static void oled_wr(uint8_t ctrl, const uint8_t *data, int len) {
    i2c_cmd_handle_t cmd = i2c_cmd_link_create();
    i2c_master_start(cmd);
    i2c_master_write_byte(cmd, (ADDR << 1) | I2C_MASTER_WRITE, true);
    i2c_master_write_byte(cmd, ctrl, true);
    if (data) i2c_master_write(cmd, (uint8_t *)data, len, true);
    i2c_master_stop(cmd);
    esp_err_t e = i2c_master_cmd_begin(I2C, cmd, pdMS_TO_TICKS(20));
    if (e != ESP_OK) ESP_LOGW(TAG, "I2C write failed: %d", e);
    i2c_cmd_link_delete(cmd);
}

static void oled_cmd(uint8_t c) { oled_wr(0x00, &c, 1); }

/* ── Public API ─────────────────────────────────────────────── */

void display_deinit(void) {
    i2c_driver_delete(I2C);
}

void display_init(void) {
    i2c_config_t conf = {
        .mode = I2C_MODE_MASTER,
        .sda_io_num = SDA,
        .scl_io_num = SCL,
        .sda_pullup_en = GPIO_PULLUP_ENABLE,
        .scl_pullup_en = GPIO_PULLUP_ENABLE,
        .master.clk_speed = 100000,
    };
    ESP_ERROR_CHECK(i2c_param_config(I2C, &conf));
    ESP_ERROR_CHECK(i2c_driver_install(I2C, conf.mode, 0, 0, 0));

    static const uint8_t init[] = {
        0xAE, 0xD5,0x80, 0xA8,0x3F, 0xD3,0x00, 0x40,
        0x8D,0x14, 0x20,0x00, 0xA1, 0xC8, 0xDA,0x12,
        0x81,0xCF, 0xD9,0xF1, 0xDB,0x40, 0xA4, 0xA6,
        0x2E, 0xAF,
    };
    for (int i = 0; i < sizeof(init); i++) oled_cmd(init[i]);

    memset(fb, 0, sizeof(fb));
    ESP_LOGI(TAG, "init ok (SDA=%d SCL=%d)", SDA, SCL);
}

void display_clear(void) {
    memset(fb, 0, sizeof(fb));
}

void display_text(int row, int col, const char *str) {
    int page = row;
    int x0   = col * 8;
    for (int i = 0; str[i] && x0 + i * 8 < W; i++) {
        int ch = str[i] - 32;
        if (ch < 0 || ch > 94) ch = 0;
        const uint8_t *glyph = font8[ch];
        for (int x = 0; x < 8; x++) {
            uint8_t byte = 0;
            for (int y = 0; y < 8; y++)
                if (glyph[y] & (1 << x)) byte |= (1 << y);
            if (x0 + i * 8 + x < W)
                fb[page * W + x0 + i * 8 + x] = byte;
        }
    }
}

void display_show(void) {
    oled_cmd(0x21); oled_cmd(0); oled_cmd(W - 1);
    oled_cmd(0x22); oled_cmd(0); oled_cmd(PGS - 1);
    oled_wr(0x40, fb, sizeof(fb));
}
